## firmware/components/google-mqtt/Kconfig
```kconfig
menu "Google IoT Configuration"

config GIOT_PROJECT_ID
    string "Google Cloud Project ID"
    default "project_id"
    help
        Google Cloud project ID

config GIOT_LOCATION
    string "Google Cloud location"
    default "us-central1-a"
    help
        Google Cloud region

config GIOT_REGISTRY_ID
    string "Google IoT Core Registry ID"
    default "registry_id"
    help
        Google IoT Core registry id

config GIOT_WIFI_AP
    string "Google IoT Core WiFi AP"
    default ""
    help
        Wireless AP to connect to.

config GIOT_WIFI_PASSWORD
    string "Google IoT Core WiFi Password"
    default ""
    help
        Password of the wireless AP to connect to.

endmenu
```
